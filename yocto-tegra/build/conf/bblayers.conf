## yocto-tegra/build/conf/bblayers.conf
```bitbake
# POKY_BBLAYERS_CONF_VERSION is increased each time build/conf/bblayers.conf
# changes incompatibly
POKY_BBLAYERS_CONF_VERSION = "2"

BBPATH = "${TOPDIR}"
BBFILES ?= ""

BBLAYERS ?= " \
  /home/vbharath/yocto-tegra/poky/meta \
  /home/vbharath/yocto-tegra/poky/meta-poky \
  /home/vbharath/yocto-tegra/poky/meta-yocto-bsp \
  /home/vbharath/yocto-tegra/meta-openembedded/meta-oe \
  /home/vbharath/yocto-tegra/meta-qt5 \
  /home/vbharath/yocto-tegra/meta-openembedded/meta-python \
  /home/vbharath/yocto-tegra/meta-openembedded/meta-webserver \
  /home/vbharath/yocto-tegra/meta-openembedded/meta-networking \
  /home/vbharath/yocto-tegra/meta-openembedded/meta-multimedia \
  /home/vbharath/yocto-tegra/meta-tegra \
  /home/vbharath/yocto-tegra/meta-custom \
  /home/vbharath/yocto-tegra/meta-openembedded/meta-filesystems \
  /home/vbharath/yocto-tegra/meta-virtualization \
  "
```
